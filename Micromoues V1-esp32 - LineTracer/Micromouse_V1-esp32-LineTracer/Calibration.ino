//Calibration

static const unsigned char PROGMEM calibrating[] =
{ //Calibrating Logo
  0x00, 0x00, 0x00, 0x01, 0xc1, 0x07, 0x80, 0x00, 0x00, 0x00, 0x00, 0x01, 0x00, 0x00, 0x00, 0x00,
  0x01, 0xfc, 0x00, 0x01, 0xc3, 0xc7, 0x80, 0x00, 0x00, 0x00, 0x00, 0x07, 0x80, 0x00, 0x00, 0x00,
  0x07, 0xfc, 0x00, 0x01, 0xc3, 0xc7, 0x80, 0x00, 0x00, 0x00, 0x00, 0x07, 0x80, 0x00, 0x00, 0x00,
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  0x00, 0x00, 0x00, 0x00, 0x00, 0x00, 0x00, 0x00, 0x00, 0x00, 0x00, 0x00, 0x00, 0x00, 0x00, 0x00
};

boolean Update = false;
unsigned long calibrationTime = 0;

int analogMaxvalue = 4095;
int pixelWidth = 25;

void calibration()
{
  // int sensors = 0;
  // for (int i = 0; i < sizeof(IRRecPin); i++)
  // {
  //   sensors++;
  // }
  
  // do {} while (digitalRead(bStart) == 1);//wait until button is realeased
  // // digitalWrite(buzzer, LOW);
  // digitalWrite(led, LOW);

  //////////////////////////////////////////////////////////////////////////////////////////
  calibrationTime = millis();
  do
  {
    //    motor(20, 20);
    int value = 0;

    OLED.clearDisplay();
    for (int i = 0; i < sizeof(IRRecPin); i++)
    {
      value = analogRead(IRRecPin[i]);
      OLED.drawRect(i * pixelWidth, 32, pixelWidth, 32, SSD1306_WHITE);
      OLED.fillRect(i * pixelWidth, 64 - map(value, 0, analogMaxvalue, 0, 32), pixelWidth, map(value, 0, analogMaxvalue, 0, 32), SSD1306_WHITE);

      if (minIR[i] > value) {
        minIR[i] = value;
      }
      else if (maxIR[i] < value)
      {
        maxIR[i] = value;
      }
      midIR[i] = ( minIR[i] + maxIR[i] ) * 0.5;

      Serial.print("  ");
      Serial.print(i);
      Serial.print(" = ");
      Serial.print(midIR[i]);
      Serial.print("  ");

    }
    Serial.println("  ");
    OLED.drawBitmap(  (OLED.width()  - 128 ) / 2, (OLED.height() - 64) / 2, calibrating, 128, 25, 1);
    OLED.display();
    Update = true;
  } while ((millis() - calibrationTime) < 5000);

  //////////////////////////////////////////////////////////////////////////////////////////

  calibrationTime = millis();
  do
  {
    //    motor(-20, -20);
    int value = 0;

    OLED.clearDisplay();
    for (int i = 0; i < sizeof(IRRecPin); i++)
    {
      value = analogRead(IRRecPin[i]);
      OLED.drawRect(i * pixelWidth, 32, pixelWidth, 32, SSD1306_WHITE);
      OLED.fillRect(i * pixelWidth, 64 - map(value, 0, analogMaxvalue, 0, 32), pixelWidth, map(value, 0, analogMaxvalue, 0, 32), SSD1306_WHITE);

      if (minIR[i] > value) {
        minIR[i] = value;
      }
      else if (maxIR[i] < value)
      {
        maxIR[i] = value;
      }
      midIR[i] = ( minIR[i] + maxIR[i] ) * 0.5;

      Serial.print("  ");
      Serial.print(i);
      Serial.print(" = ");
      Serial.print(midIR[i]);
      Serial.print("  ");

    }
    Serial.println("  ");
    OLED.display();
    Update = true;

  } while ((millis() - calibrationTime) < 5000);

  //////////////////////////////////////////////////////////////////////////////////////////
  OLED.clearDisplay();
  for (int i = 0; i < sizeof(IRRecPin); i++)
  {
    OLED.setTextSize(2);
    OLED.setTextColor(SSD1306_WHITE);
    OLED.setCursor(0, 0);
    OLED.cp437(true);
    OLED.print("Calibrated");

    OLED.drawRect(i * pixelWidth, 32, pixelWidth, 32, SSD1306_WHITE);
    OLED.fillRect(i * pixelWidth, 64 - map(midIR[i], 0, analogMaxvalue, 0, 32), pixelWidth, map(midIR[i], 0, analogMaxvalue, 0, 32), SSD1306_WHITE);
  }

  OLED.display(); //update the display

  //////////////////////////////////////////////////////////////////////////////////////////
  //  motor(0, 0);
  // Update=true;
  // updateEEPROM();
  // do {
  //   IR_Recv();
  // } while ((digitalRead(bStart) == 0) && (irRecvResults.value != 0xFF38C7)); //wait until button is pressed
  // do {
  //   IR_Recv();
  // } while ((digitalRead(bStart) == 1) || (irRecvResults.value == 0xFF38C7)); //ensure button is released
  store_memory();
  delay(3000);
  Start = 0;
}

///////////////////////////////////////////////////////////////////////////////////////////////////////////////////////////////

// void updateEEPROM()
// {
//   if (Update == true)
//   {
//     for (int i = 0; i < sizeof(IR); i++)
//     {
//       EEPROM.update(i, (midIR[i] / 4));
//       Serial.print( midIR[i], DEC);
//       Serial.print(" ");
//     }
//     Update = false;
//     Serial.println( );
//   }
//   else
//   {
//   }
// }

// ///////////////////////////////////////////////////////////////////////////////////////////////////////////////////////////////

// void readEEPROM() {
//   for (int i = 0; i < sizeof(IR); i++)
//   {
//     midIR[i] = EEPROM.read(i) * 4;
//     Serial.print( i);
//     Serial.print(" = ");
//     Serial.print( (midIR[i] ), DEC);
//     Serial.print("  ");
//   }
//   Serial.println( );
// }

////////////////////////////////////////////////////////////////////////////////////////////////
//  
// save calibration values into esp32
#include <Preferences.h>
Preferences preferences;

unsigned int IR1 = 0;
unsigned int IR2 = 0;
unsigned int IR3 = 0;
unsigned int IR4 = 0;
unsigned int IR5 = 0;

void read_memory() {
  preferences.begin("lineData", false);

  // retrieve saved data
  midIR[0] = preferences.getUInt("IR1", 0);
  midIR[1] = preferences.getUInt("IR2", 0);
  midIR[2] = preferences.getUInt("IR3", 0);
  midIR[3] = preferences.getUInt("IR4", 0);
  midIR[4] = preferences.getUInt("IR5", 0);

}

void store_memory()
{
  preferences.putUInt("IR1", midIR[0]);
  preferences.putUInt("IR2", midIR[1]);
  preferences.putUInt("IR3", midIR[2]);
  preferences.putUInt("IR4", midIR[3]);
  preferences.putUInt("IR5", midIR[4]);
  preferences.end();
}





